## conf/layer.conf
```bitbake
# We have a conf and classes directory, add to BBPATH
BBPATH .= ":${LAYERDIR}"

# We have recipes-* directories, add to BBFILES
BBFILES += "${LAYERDIR}/recipes-*/*/*.bb \
            ${LAYERDIR}/recipes-*/*/*.bbappend"

BBFILE_COLLECTIONS += "testlayer"
BBFILE_PATTERN_testlayer = "^${LAYERDIR}/"
BBFILE_PRIORITY_testlayer = "8"
LAYERVERSION_testlayer = "4"
LAYERSERIES_COMPAT_testlayer = "hardknott"
```
